
qcom,ascent-3820mah {
	/* #3197413_Wind_E300atl_3820mAh_averaged_MasterSlave_Nov27th2017*/
	qcom,max-voltage-uv = <4350000>;
	qcom,v-cutoff-uv = <3400000>;                     //liulinsheng@wind-mobi.com 
	qcom,nom-batt-capacity-mah = <3820>;
	qcom,batt-id-kohm = <100>;
	qcom,battery-beta = <3435>;
	qcom,battery-type = "ascent_3820mah";
	qcom,chg-rslow-comp-c1 = <3445848>;
	qcom,chg-rslow-comp-c2 = <5283394>;
	qcom,chg-rs-to-rslow = <769372>;
	qcom,chg-rslow-comp-thr = <0xAC>;
	qcom,checksum = <0x699E>;
	qcom,gui-version = "PMI8950GUI - 2.0.0.16";
	qcom,fg-profile-data = [
		 E0 83 C5 7C 
		 00 81 FA 76 
		 61 83 3C 6F 
		 FE 88 2C 94 
		 51 82 75 98 
		 55 B6 0A C2 
		 52 14 FF 83 
		 77 7D 6E 81 
		 AF 77 4D 83 
		 8D 70 99 6A 
		 2C 84 54 82 
		 70 99 AA BC 
		 6A C9 59 0D 
		 2B 0F 14 5A 
		 14 70 15 FD 
		 C1 3C 7A 44 
		 1E 3A 00 00 
		 F3 45 69 31 
		 FD 16 00 00 
		 00 00 00 00 
		 00 00 00 00 
		 61 6A 4E 69 
		 B0 78 0F 8B 
		 B0 74 78 69 
		 52 53 0B 80 
		 17 6E BE 61 
		 E4 74 44 A8 
		 1B A4 62 AA 
		 64 A0 71 0C 
		 28 00 FF 36 
		 F0 11 30 03 
		 00 00 00 0C 
	];
};
