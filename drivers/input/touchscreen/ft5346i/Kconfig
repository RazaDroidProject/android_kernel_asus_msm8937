## drivers/input/touchscreen/ft5346i/Kconfig
```kconfig
#hebiao@wind-mobi.com 20170824 begin
#
# Focaltech Touchscreen driver configuration
#
config TOUCHSCREEN_FT5346I
        bool "Focaltech Touchscreen"
		depends on I2C
		default n
		help
		  Say Y here if you have Focaltech touch panel.
		  If unsure, say N.

config TOUCHSCREEN_FTS
        bool "Focaltech Touchscreen"
		depends on I2C
		default n
		help
		  Say Y here if you have Focaltech touch panel.
		  If unsure, say N.

config TOUCHSCREEN_FTS_DIRECTORY
    string "Focaltech ts directory name"
    default "focaltech_touch"
    depends on TOUCHSCREEN_FTS
#hebiao@wind-mobi.com 20170824 end  
  
```

## drivers/input/touchscreen/gt917d/Kconfig
```kconfig
#hebiao@wind-mobi.com 20170824 begin
#
# GT Touchscreen driver configuration
#
config TOUCHSCREEN_GT917D
        bool "GT Touchscreen"
		depends on I2C
		default n
		help
		  Say Y here if you have Focaltech touch panel.
		  If unsure, say N.
#hebiao@wind-mobi.com 20170824 end  
  
```

## drivers/misc/qcom/sim_int_default_set/Kconfig
```kconfig
# add by zhaozhensen@wind-mobi.com 20170110 begin
config WIND_ASUS_SIM_DEFAULT_CONFIG
  bool "CONFIG_WIND_ASUS_SIM_DEFAULT_CONFIG"
  default n
  help
    CONFIG_WIND_ASUS_SIM_DEFAULT_CONFIG
# add by zhaozhensen@wind-mobi.com 20170110 end
```

## drivers/misc/qcom/usb_temp_check/Kconfig
```kconfig
#liulinsheng@wind-mobi.com 20171023 begin
config WIND_ASUS_USB_TEMP_CHECK
  bool "CONFIG_WIND_ASUS_USB_TEMP_CHECK"
  default n
  help
    CONFIG_WIND_ASUS_USB_TEMP_CHECK
#liulinsheng@wind-mobi.com 20171023 end
```

## drivers/misc/wind_device_info/Kconfig
```kconfig
#lihaiyan@wind-mobi.com 20171101 begin
config WIND_DEVICE_INFO
	bool "CONFIG_WIND_DEVICE_INFO"
	default y
	help
		Select y or n
#lihaiyan@wind-mobi.com 20171101 end
```

## drivers/misc/wind_driver/Kconfig
```kconfig
## lihaiyan@wind-mobi.com 20171101 +++


config WIND_DEVICE_INFO
	bool "CONFIG_WIND_DEVICE_INFO"
	default N
	help
		Select y or n

source "drivers/misc/wind_driver/fingerprint/Kconfig"
source "drivers/misc/wind_driver/dtv/fc8350/Kconfig"		

## lihaiyan@wind-mobi.com 20171101 ---
```

## drivers/misc/wind_driver/dtv/fc8350/Kconfig
```kconfig
## /* add by lihaiyan start  */
config DTV_FC8350_SUPPORT
    tristate "LeadCore Finger Print Driver"
	default n
    help
        LeadCore Finger Print Supported
## /* add by lihaiyan end  */
```

## drivers/misc/wind_driver/fingerprint/Kconfig
```kconfig
source "drivers/misc/wind_driver/fingerprint/leadcore/Kconfig"
source "drivers/misc/wind_driver/fingerprint/microarray/Kconfig"
source "drivers/misc/wind_driver/fingerprint/sunwave/Kconfig"
```

## drivers/misc/wind_driver/fingerprint/leadcore/Kconfig
```kconfig
## /* add by leadcore start  */
config LEADCORE_FINGERPRINT
    tristate "LeadCore Finger Print Driver"
	default n
    help
        LeadCore Finger Print Supported
## /* add by leadcore end  */
```

## drivers/misc/wind_driver/fingerprint/microarray/Kconfig
```kconfig
## add by microarray start
# Copyright (C) MicroArray  
# MicroArray Fprint Driver Code
# Kconfig
# Date: 2017-3-15
# Version: v4.0.06
# Author: guq
# Contact: guq@microarray.com.cn

config MICROARRAY_FINGERPRINT
	tristate "microarray Fingerprint"
	default n
	help
	  If you say Y to this option, support will be included for 
	  the Microarray's fingerprint sensor. This driver supports 
	  both REE and TEE. If in REE, CONFIG_SPI_SPIDEV must be set 
	  to use the standard 'spidev' driver.
	
	  This driver can also be built as a module. If so, the module
	  will be called 'MICROARRAY'.
## add by microarray end	  
	  
	  
```

## drivers/platform/asus/Kconfig
```kconfig
# Asus configuration options

config MACH_ASUS_MSM8937
	bool "Asus MSM8937"
	depends on ARCH_MSM8937
	help
	  Support for MSM8937 Asus variants

menu "Asus board selection"

config MACH_ASUS_X00P
	bool "X00P board"
	select MACH_ASUS_MSM8937
	help
	  Support for Asus Max M1

endmenu
```
